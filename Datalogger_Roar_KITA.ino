#include <Wire.h>  // Library untuk komunikasi I2C
#include <Adafruit_SSD1306.h>  // Library untuk mengontrol OLED menggunakan Adafruit GFX
#include <Adafruit_GFX.h>  // Library pendukung untuk menggambar grafis
#include <RTClib.h>  // Library untuk RTC (Real Time Clock)
#include <SPI.h>  // Library untuk komunikasi SPI
#include <SD.h>  // Library untuk mengakses SD Card
#include <FS.h>  // Library untuk sistem file

#define OLED_Address 0x3C // Alamat I2C dari modul OLED
#define SCREEN_WIDTH 128  // Lebar layar OLED dalam piksel
#define SCREEN_HEIGHT 64  // Tinggi layar OLED dalam piksel

// Pin CS (Chip Select) untuk SD Card
#define SD_CS_PIN 5

// Membuat objek layar OLED dengan resolusi 128x64, menggunakan I2C dan tanpa reset pin
Adafruit_SSD1306 oled(SCREEN_WIDTH, SCREEN_HEIGHT, &Wire, -1);


// Gambar dalam format bitmap (ganti dengan array hasil konversi)
const uint8_t logo_bitmap[] PROGMEM = {
  0x00, 0x00, 0x00, 0x00, 0x00, 0x00, 0x00, 0x00, 0x00, 0x00, 0x00, 0x00, 0x00, 0x00, 0x00, 0x00, 
	0x00, 0x00, 0x00, 0x00, 0x00, 0x00, 0x00, 0x00, 0x07, 0xff, 0xc0, 0x00, 0x00, 0x00, 0x00, 0x00, 
	0x00, 0x00, 0x7f, 0xff, 0xfc, 0x00, 0x00, 0x00, 0x00, 0x00, 0x00, 0x03, 0xff, 0xff, 0xff, 0x00, 
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	0x00, 0x00, 0x00, 0x00, 0x00, 0x00, 0x00, 0x00, 0x00, 0x00, 0x00, 0x00, 0x00, 0x00, 0x00, 0x00 // Gambar bitmap lainnya
};

// Membuat objek RTC untuk modul DS3231
RTC_DS3231 rtc; // RTC untuk pengaturan waktu real-time

int LastTime = 0; // Variabel untuk menyimpan waktu sebelumnya
int ThisTime; // Variabel untuk menyimpan waktu saat ini
bool BPMTiming = false; // Menandai apakah penghitungan BPM sedang berlangsung
bool BeatComplete = false; // Menandai apakah detak jantung sudah selesai dihitung
int BPM = 0; // Variabel untuk menyimpan nilai BPM (Beats Per Minute)

#define UpperThreshold 560 // Batas atas untuk mendeteksi detak jantung
#define LowerThreshold 530 // Batas bawah untuk mendeteksi detak jantung

File dataFile; // Objek file untuk mengakses data pada SD card

void setup() {
  Serial.begin(115200); // Inisialisasi komunikasi serial dengan baud rate 115200
  delay(1000); // Menunggu Serial Monitor siap sebelum melanjutkan
  
  // Inisialisasi layar OLED
  if (!oled.begin(SSD1306_SWITCHCAPVCC, OLED_Address)) { // Cek apakah OLED berhasil diinisialisasi
    Serial.println(F("Gagal menginisialisasi OLED!")); // Pesan error jika OLED gagal
    while (1); // Berhenti jika terjadi kegagalan
  }
  oled.clearDisplay(); // Membersihkan layar OLED
  oled.setTextSize(1); // Mengatur ukuran teks menjadi 1
  oled.setTextColor(SSD1306_WHITE); // Mengatur warna teks menjadi putih
  
  // Menampilkan logo pada OLED
  oled.drawBitmap(0, 0, logo_bitmap, 80, 64, SSD1306_WHITE); // Menampilkan logo bitmap pada layar OLED
  oled.display(); // Memperbarui layar OLED untuk menampilkan logo
  delay(2000); // Menunggu 2 detik untuk menampilkan logo
  oled.clearDisplay(); // Membersihkan layar OLED setelah menampilkan logo

  // Inisialisasi RTC (Real Time Clock)
  if (!rtc.begin()) { // Cek apakah RTC berhasil diinisialisasi
    Serial.println("Gagal menginisialisasi RTC!"); // Pesan error jika RTC gagal
    while (1); // Berhenti jika terjadi kegagalan
  }

  // Inisialisasi SD Card
  if (!SD.begin(SD_CS_PIN)) { // Cek apakah SD card berhasil diinisialisasi
    Serial.println("Gagal menginisialisasi SD Card!"); // Pesan error jika SD Card gagal
    while (1); // Berhenti jika terjadi kegagalan
  }

  // Membuka file untuk menulis data
  dataFile = SD.open("/datalog.txt", FILE_APPEND); // Membuka file dalam mode append
  if (dataFile) { // Cek apakah file berhasil dibuka
    dataFile.println("Waktu, Sensor, BPM"); // Menulis header data ke file
    dataFile.close(); // Menutup file setelah menulis
  } else {
    Serial.println("Gagal membuka file untuk penyimpanan!"); // Pesan error jika file gagal dibuka
  }
}

void loop() {
  ThisTime = millis(); // Mendapatkan waktu saat ini dalam milidetik sejak perangkat mulai
int value = analogRead(33); // Membaca nilai analog dari pin GPIO33

// Menghitung BPM (Beats Per Minute)
if (value > UpperThreshold) { // Jika nilai sensor melebihi batas atas
  if (BeatComplete) { // Jika siklus detak sebelumnya selesai
    BPM = ThisTime - LastTime; // Hitung selisih waktu antara dua detak
    BPM = int(60 / (float(BPM) / 1000)); // Mengkonversi waktu antar detak menjadi BPM
    BPMTiming = false; // Reset status timing BPM
    BeatComplete = false; // Reset status detak selesai
  }
  if (!BPMTiming) { // Jika detak baru dimulai
    LastTime = millis(); // Mencatat waktu saat detak terdeteksi
    BPMTiming = true; // Menandai bahwa penghitungan waktu dimulai
  }
}
if ((value < LowerThreshold) && BPMTiming) { // Jika nilai sensor di bawah batas bawah dan BPM sedang dihitung
  BeatComplete = true; // Tandai bahwa siklus detak telah selesai
}

// Mendapatkan waktu saat ini dari RTC
DateTime now = rtc.now(); // Membaca waktu dan tanggal dari RTC

// Membersihkan layar OLED
oled.clearDisplay(); // Menghapus konten layar OLED sebelumnya

// Menampilkan waktu dan tanggal di OLED dalam satu baris
oled.setTextSize(1); // Mengatur ukuran teks menjadi kecil
oled.setCursor(0, 0); // Menempatkan kursor di pojok kiri atas
oled.print(now.year()); // Menampilkan tahun
oled.print('/'); // Pemisah '/'
oled.print(now.month()); // Menampilkan bulan
oled.print('/'); // Pemisah '/'
oled.print(now.day()); // Menampilkan tanggal
oled.print("  "); // Spasi untuk memisahkan waktu
oled.print(now.hour()); // Menampilkan jam
oled.print(':'); // Pemisah ':'
oled.print(now.minute()); // Menampilkan menit
oled.print(':'); // Pemisah ':'
oled.print(now.second()); // Menampilkan detik

  // Menampilkan teks "Sensor" dan nilai sensor
oled.setCursor((SCREEN_WIDTH - 6 * 7) / 2, 25); // Mengatur posisi teks "Sensor:" di tengah layar, pada baris ke-3
oled.print("Sensor:"); // Menampilkan teks "Sensor:" pada OLED
oled.setCursor((SCREEN_WIDTH - 6 * String(value).length()) / 2, 35); // Mengatur posisi nilai sensor di bawah teks "Sensor:"
oled.println(value); // Menampilkan nilai sensor pada OLED

// Menampilkan teks "BPM" dan nilai BPM
oled.setCursor((SCREEN_WIDTH - 6 * 4) / 2, 45); // Mengatur posisi teks "BPM:" di tengah layar, pada baris ke-4
oled.print("BPM:"); // Menampilkan teks "BPM:" pada OLED
oled.setCursor((SCREEN_WIDTH - 6 * String(BPM).length()) / 2, 55); // Mengatur posisi nilai BPM di bawah teks "BPM:"
oled.println(BPM); // Menampilkan nilai BPM pada OLED

// Memperbarui tampilan OLED
oled.display(); // Mengirimkan data terbaru ke layar OLED untuk ditampilkan

// Menyimpan data ke MicroSD
dataFile = SD.open("/datalog.txt", FILE_APPEND); // Membuka file "datalog.txt" dalam mode append (tambahkan data baru)
if (dataFile) { // Memastikan file berhasil dibuka
  dataFile.print(now.year()); // Menyimpan tahun saat ini ke file
  dataFile.print('/'); // Menambahkan pemisah '/'
  dataFile.print(now.month()); // Menyimpan bulan saat ini ke file
  dataFile.print('/'); // Menambahkan pemisah '/'
  dataFile.print(now.day()); // Menyimpan tanggal saat ini ke file
  dataFile.print(" "); // Menambahkan spasi sebagai pemisah
  dataFile.print(now.hour()); // Menyimpan jam saat ini ke file
  dataFile.print(':'); // Menambahkan pemisah ':'
  dataFile.print(now.minute()); // Menyimpan menit saat ini ke file
  dataFile.print(':'); // Menambahkan pemisah ':'
  dataFile.print(now.second()); // Menyimpan detik saat ini ke file
  dataFile.print(", "); // Menambahkan koma sebagai pemisah
  dataFile.print(value); // Menyimpan nilai sensor ke file
  dataFile.print(", "); // Menambahkan koma sebagai pemisah
  dataFile.println(BPM); // Menyimpan nilai BPM ke file dan pindah ke baris baru
  dataFile.close(); // Menutup file setelah selesai menulis
} else {
  Serial.println("Gagal membuka file untuk penulisan!"); // Menampilkan pesan error jika file gagal dibuka
}

delay(2000); // Menunda 2 detik sebelum pembaruan data berikutnya
}
